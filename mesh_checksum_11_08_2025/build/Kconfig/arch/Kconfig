## mesh_checksum_11_08_2025/build/Kconfig/arch/Kconfig
```kconfig
# Load Zephyr Arch Kconfig descriptions.
osource "C:/Users/ZainSiddiqui/zephyrproject/external/zephyr/arch/x86/Kconfig"
osource "C:/Users/ZainSiddiqui/zephyrproject/external/zephyr/arch/xtensa/Kconfig"
osource "C:/Users/ZainSiddiqui/zephyrproject/external/zephyr/arch/sparc/Kconfig"
osource "C:/Users/ZainSiddiqui/zephyrproject/external/zephyr/arch/riscv/Kconfig"
osource "C:/Users/ZainSiddiqui/zephyrproject/external/zephyr/arch/posix/Kconfig"
osource "C:/Users/ZainSiddiqui/zephyrproject/external/zephyr/arch/nios2/Kconfig"
osource "C:/Users/ZainSiddiqui/zephyrproject/external/zephyr/arch/mips/Kconfig"
osource "C:/Users/ZainSiddiqui/zephyrproject/external/zephyr/arch/arm64/Kconfig"
osource "C:/Users/ZainSiddiqui/zephyrproject/external/zephyr/arch/arm/Kconfig"
osource "C:/Users/ZainSiddiqui/zephyrproject/external/zephyr/arch/arc/Kconfig"
```

## mesh_checksum_11_08_2025/build/Kconfig/boards/Kconfig.nucleo_f401re
```kconfig
# Load board Kconfig descriptions.
osource "C:/Users/ZainSiddiqui/zephyrproject/external/zephyr/boards/st/nucleo_f401re/Kconfig.nucleo_f401re"
```

## mesh_checksum_11_08_2025/build/nucleo_f401re/Kconfig/boards/Kconfig
```kconfig
# Load Zephyr board Kconfig descriptions.
osource "C:/Users/ZainSiddiqui/zephyrproject/external/zephyr/boards/st/nucleo_f401re/Kconfig"
```

## mesh_checksum_11_08_2025/build/nucleo_f401re/Kconfig/boards/Kconfig.defconfig
```kconfig
# Load Zephyr board defconfig descriptions.
osource "C:/Users/ZainSiddiqui/zephyrproject/external/zephyr/boards/st/nucleo_f401re/Kconfig.defconfig"
```

## mesh_checksum_11_08_2025/build/nucleo_f401re_sx1272/Kconfig/Kconfig.shield
```kconfig
osource "c:\Users\ZainSiddiqui\zephyrproject\external\zephyr/boards/shields/*/Kconfig.shield"
```

## mesh_checksum_11_08_2025/build/nucleo_f401re_sx1272/Kconfig/Kconfig.shield.defconfig
```kconfig
osource "c:\Users\ZainSiddiqui\zephyrproject\external\zephyr/boards/shields/*/Kconfig.defconfig"
```
